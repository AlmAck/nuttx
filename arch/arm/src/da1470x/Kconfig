## boards/arm/da1470x/da14706-00hzdevkt-p/Kconfig
```kconfig
#
# For a description of the syntax of this configuration file,
# see the file kconfig-language.txt in the NuttX tools repository.
#

if ARCH_BOARD_DA14706_00HZDEVKT_P

config DA14706_LCD_E120A390QSR
	bool "E120A390QSR 390x390 AMOLED daughterboard"
	default n
	depends on DA1470X_LCDC
	---help---
		Register the EverDisplay E120A390QSR (Raydium RM69091) panel
		attached to the LCDC in quad-SPI mode as the framebuffer.

config DA14706_LCD_LPM012M134B
	bool "JDI LPM012M134B 240x240 memory-in-pixel panel (parallel)"
	default n
	depends on DA1470X_LCDC && !DA14706_LCD_E120A390QSR
	---help---
		Register a JDI LPM012M134B panel on the JDI parallel interface
		as the framebuffer (RGB332, eight colours on the panel).  The
		devkit does not carry this panel: the JDI pads are the chip's
		fixed ones, the enable pin is BOARD_JDI_PEN_PIN.

config DA14706_OQSPI_MOUNTPOINT
	string "Mount point of the flash data partition"
	default "/mnt/flash"
	depends on DA1470X_OQSPI_MTD

endif
```

## drivers/power/battery/Kconfig
```kconfig
#
# For a description of the syntax of this configuration file,
# see the file kconfig-language.txt in the NuttX tools repository.
#

menu "Battery Management Support"

config BATTERY_CHARGER
	bool "Battery Charger support"
	default n

config BQ2425X
	bool "BQ2425X Battery charger support"
	default n
	select I2C
	select I2C_BQ2425X
	depends on BATTERY_CHARGER
	depends on ALLOW_BSD_COMPONENTS
	---help---
		The BQ24250/BQ24251 are battery charger for lithium-ion batteries.

config I2C_BQ2425X
	bool

config BQ2429X
	bool "BQ2429X Battery charger support"
	default n
	select I2C
	select I2C_BQ2429X
	depends on BATTERY_CHARGER
	---help---
		The BQ24296/BQ24297/BQ24296M are battery charger for lithium-ion batteries.

config I2C_BQ2429X
	bool

if BQ2429X

config DEBUG_BQ2429X
	bool "BQ2429X Debug Features"
	default n
	---help---
		Enable BQ2429X battery management debug features.

endif # BQ2429X

config AXP202
	bool "AXP202 Battery charger support"
	default n
	select I2C
	select I2C_AXP202
	depends on BATTERY_CHARGER
	---help---
		axp202 are battery charger for lithium-ion batteries.

config I2C_AXP202
	bool

config AXP202_DC2_VOLTAGE
	int "AXP202 DC2 output voltage"
	default 0
	depends on AXP202
	---help---
		AXP202 DC2 output voltage. 0 is disable, enable range: [700, 2275] mV.

config AXP202_DC3_VOLTAGE
	int "AXP202 DC3 output voltage"
	default 3300
	depends on AXP202
	---help---
		AXP202 DC3 output voltage. 0 is disable, enable range: [700, 3500] mV.

config AXP202_LDO2_VOLTAGE
	int "AXP202 LDO2 output voltage"
	default 0
	depends on AXP202
	---help---
		AXP202 LDO2 output voltage. 0 is disable, enable range: [1800, 3300] mV.

config AXP202_LDO3_VOLTAGE
	int "AXP202 LDO3 output voltage"
	default 0
	depends on AXP202
	---help---
		Enable LDO3 output voltage. 0 is disable, enable range: [700, 2275] mV.

config AXP202_LDO4_VOLTAGE
	int "AXP202 LDO4 output voltage"
	default 0
	depends on AXP202
	---help---
		Enable LDO4 output voltage. 0 is disable, other value:
			1250 1300 1400 1500 1600 1700 1800 1900
			2000 2500 2700 2800 3000 3100 3200 3300 mV.

config MCP73871
	bool "Microchip MCP73871 Battery charger support"
	default n
	depends on BATTERY_CHARGER
	---help---
		A simple driver to report MCP73871 status.

config BATTERY_GAUGE
	bool "Battery Fuel Gauge support"
	default n

config MAX1704X
	bool "MAX1704X Battery fuel gauge support"
	default n
	select I2C
	select I2C_MAX1704X
	depends on BATTERY_GAUGE
	---help---
		The MAX17040/MAX17041 are ultra-compact, low-cost, host-side fuel-gauge
		systems for lithium-ion (Li+) batteries in handheld and portable equipment.
		The MAX17040 is configured to operate with a single lithium cell and the
		MAX17041 is configured for a dual-cell 2S pack.

config BATTERY_MAX20303
	bool "MAX20303 wearable PMIC (fuel gauge + charger + haptic)"
	default n
	select I2C
	depends on BATTERY_GAUGE
	---help---
		Maxim MAX20303 wearable PMIC: registers the integrated
		ModelGauge fuel gauge as a battery_gauge device, configures and
		enables the Li+ charger, and exposes the haptic motor driver as
		a character device (write max20303_haptic_sample_s arrays).
		Power rails (LDO/buck) are not touched unless
		MAX20303_LDO1_MV is set.

if BATTERY_MAX20303

config MAX20303_I2C_FREQUENCY
	int "MAX20303 I2C frequency"
	default 400000

config MAX20303_LDO1_MV
	int "LDO1 output voltage in mV (0 = leave rail untouched)"
	default 0
	range 0 1950
	---help---
		If nonzero, program LDO1 to this output voltage (500-1950 mV,
		25 mV steps) and enable it during registration. Needed on boards
		that power a sensor rail from LDO1: the MAX20303B OTP default
		leaves it disabled. Leave at 0 on boards where the
		rail must not be touched.

config MAX20303_LDO2_MV
	int "LDO2 output voltage in mV (0 = leave rail untouched)"
	default 0
	range 0 4000
	---help---
		If nonzero, program LDO2 to this output voltage (900-4000 mV,
		100 mV steps) and enable it during registration. The MAX20303B
		OTP default leaves it disabled. Leave at 0 on boards where the
		rail must not be touched.

config MAX20303_HAPTIC_LRA
	bool "Haptic motor is an LRA (linear resonant actuator)"
	default n
	---help---
		Configure the haptic driver for an LRA with back-EMF resonance
		tracking. Default is a plain ERM voltage drive.

if MAX20303_HAPTIC_LRA

config MAX20303_HAPTIC_LRA_HZ
	int "LRA resonant frequency (Hz)"
	default 240
	range 120 305
	---help---
		Nominal resonant frequency of the fitted motor, used as the
		back-EMF tracker's initial guess. The tracker converges from
		here, so a bad guess costs convergence time -- which matters
		because a short alert tap can be OVER before the tracker locks,
		giving a weak or wrong-feeling buzz with no error reported
		anywhere.

		The default of 240 Hz is only a starting point and is likely
		wrong for any given motor (common coin LRAs sit at 175 or
		205 Hz). Check the motor's datasheet.

		If you do not know it, boot once and read the "resonance"
		line the driver logs at registration -- the chip measures the
		motor as actually mounted, which beats the datasheet anyway.

config MAX20303_HAPTIC_PROBE_RESONANCE
	bool "Measure and log LRA resonance at registration"
	default n
	---help---
		At registration, drive the motor briefly and log the resonant
		frequency the chip's back-EMF tracker measured, alongside the
		configured guess.

		This BUZZES THE MOTOR ON EVERY BOOT (~200 ms) and costs that
		long in registration, so it is a bring-up aid, not something to
		leave enabled in a product.

		Turn it on when bringing up a new board or a new motor: it is
		the only feedback that the back-EMF tracker locked at all, and
		it reports the measured frequency to put in
		MAX20303_HAPTIC_LRA_HZ. Note the measurement spreads a few
		percent run to run, so a value anywhere in the observed band is
		equivalent -- do not chase an exact figure.

endif # MAX20303_HAPTIC_LRA

config MAX20303_HAPTIC_VFS_MV
	int "Haptic full-scale voltage in mV (0 = leave at OTP default)"
	default 0
	range 0 5500
	---help---
		Full-scale voltage (VFS) that every haptic amplitude is a
		percentage of. The driver's effective full scale is
		min(VFS, VSYS).

		Leaving this at 0 means amplitudes are relative to whatever the
		OTP default happens to be, so "35%" is not a defined physical
		drive level and may overdrive the motor. Set it to the motor's
		rated voltage.

		Quantised to 21.57 mV steps by the hardware.

endif # BATTERY_MAX20303

config I2C_MAX1704X
	bool

config BQ27426
	bool "BQ27426 Battery fuel gauge support"
	default n
	select I2C
	depends on BATTERY_GAUGE
	---help---
		The bq27426 battery fuel gauge accurately predicts the battery capacity and other
		operational characteristics of a single, Li-based, rechargeable cell.
		It can be interrogated by a system processor to provide cell information,
		such as state-of-charge (SOC).

config BATTERY_MONITOR
	bool "Battery Monitor/Management support"
	default n

config BQ769X0
	bool "BQ769X0 Battery monitor support"
	default n
	select I2C
	select I2C_BQ769X0
	depends on BATTERY_MONITOR
	---help---
		The BQ76920/BQ76930/BQ76940 provide monitoring, balancing, and
		protection features for up to 15 cells in series.

config I2C_BQ769X0
	bool

if BQ769X0
config BQ769X0_USE_INTERNAL_TS
	bool "Use internal temperature sensor on BQ769X0"
	default n
endif

config GOLDFISH_BATTERY
	bool "Goldfish Battery charger support"
	default n
	depends on BATTERY_GAUGE
	---help---
		The GOLDFISH_BATTERY are battery charger for emulate batteries.

config BATTERY_FAKE_GAUGE
	bool "Battery fake gauge support"
	default n
	depends on BATTERY_GAUGE
	---help---
		The BATTERY FAKE are battery charger for emulate gauge.

endmenu
```
