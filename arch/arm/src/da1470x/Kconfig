## arch/arm/src/da1470x/Kconfig
```kconfig
#
# For a description of the syntax of this configuration file,
# see the file kconfig-language.txt in the NuttX tools repository.
#

comment "DA1470X Configuration Options"

choice
	prompt "DA1470X Chip Selection"
	default ARCH_CHIP_DA14706
	depends on ARCH_CHIP_DA1470X

config ARCH_CHIP_DA14706
	bool "DA14706"
	select DA1470X_CPUAPP_MEM_RAM_1536
	select DA1470X_CPUAPP_MEM_FLASH_8192

endchoice # DA1470X Chip Selection

config DA1470X_APPCORE
	bool
	default n
	select DA1470X_HAVE_UART0
	select DA1470X_HAVE_UART1
	select DA1470X_HAVE_UART2
	select DA1470X_HAVE_SPI0
	select DA1470X_HAVE_SPI1
	select DA1470X_HAVE_SPI2
	select DA1470X_HAVE_I2C0
	select DA1470X_HAVE_I2C1
	select DA1470X_HAVE_I2C2

choice
	prompt "DA1470X Core Selection"
	default ARCH_CHIP_DA1470X_CPUAPP
	depends on ARCH_CHIP_DA14706

config ARCH_CHIP_DA1470X_CPUAPP
	bool "DA1470X application core (Cortex-M33)"
	select DA1470X_APPCORE

endchoice # DA1470X Core Selection

config DA1470X_CPUAPP_MEM_RAM_1536
	bool
	default n

config DA1470X_CPUAPP_MEM_RAM_SIZE
	hex
	default 0x180000 if DA1470X_CPUAPP_MEM_RAM_1536

config DA1470X_CPUAPP_MEM_FLASH_8192
	bool
	default n

config DA1470X_CPUAPP_MEM_FLASH_SIZE
	hex
	default 0x800000 if DA1470X_CPUAPP_MEM_FLASH_8192

# Peripheral availability (hidden)

config DA1470X_HAVE_UART0
	bool
	default n

config DA1470X_HAVE_UART1
	bool
	default n

config DA1470X_HAVE_UART2
	bool
	default n

config DA1470X_HAVE_SPI0
	bool
	default n

config DA1470X_HAVE_SPI1
	bool
	default n

config DA1470X_HAVE_SPI2
	bool
	default n

config DA1470X_HAVE_I2C0
	bool
	default n

config DA1470X_HAVE_I2C1
	bool
	default n

config DA1470X_HAVE_I2C2
	bool
	default n

config DA1470X_UART
	bool
	default n

config DA1470X_SPI
	bool
	default n

config DA1470X_I2C
	bool
	default n

menu "DA1470X Peripheral Selection"

config DA1470X_UART0
	bool "UART0 (datasheet UART)"
	default n
	depends on DA1470X_HAVE_UART0
	select UART0_SERIALDRIVER
	select DA1470X_UART
	select ARCH_HAVE_SERIAL_TERMIOS

config DA1470X_UART1
	bool "UART1 (datasheet UART2, RTS/CTS capable)"
	default n
	depends on DA1470X_HAVE_UART1
	select UART1_SERIALDRIVER
	select DA1470X_UART
	select ARCH_HAVE_SERIAL_TERMIOS

config DA1470X_UART2
	bool "UART2 (datasheet UART3, RTS/CTS capable)"
	default n
	depends on DA1470X_HAVE_UART2
	select UART2_SERIALDRIVER
	select DA1470X_UART
	select ARCH_HAVE_SERIAL_TERMIOS

config DA1470X_SPI0
	bool "SPI0 (datasheet SPI)"
	default n
	depends on DA1470X_HAVE_SPI0
	select DA1470X_SPI

config DA1470X_SPI1
	bool "SPI1 (datasheet SPI2)"
	default n
	depends on DA1470X_HAVE_SPI1
	select DA1470X_SPI

config DA1470X_SPI2
	bool "SPI2 (datasheet SPI3, PD_SYS)"
	default n
	depends on DA1470X_HAVE_SPI2
	select DA1470X_SPI

config DA1470X_I2C0
	bool "I2C0 (datasheet I2C)"
	default n
	depends on DA1470X_HAVE_I2C0
	select DA1470X_I2C

config DA1470X_I2C1
	bool "I2C1 (datasheet I2C2)"
	default n
	depends on DA1470X_HAVE_I2C1
	select DA1470X_I2C

config DA1470X_I2C2
	bool "I2C2 (datasheet I2C3)"
	default n
	depends on DA1470X_HAVE_I2C2
	select DA1470X_I2C

config DA1470X_DMA
	bool "DMA controller"
	default n
	---help---
		Enable the 8-channel general purpose DMA controller driver.

config DA1470X_GPIO_IRQ
	bool "GPIO interrupts (via wake-up controller)"
	default n
	---help---
		Route GPIO edge events through the WKUP block to the three
		per-port NVIC interrupts and dispatch them per pin.

config DA1470X_RTC
	bool "RTC"
	default n
	depends on !RTC_ARCH
	select RTC
	select RTC_DATETIME
	select RTC_ALARM
	select RTC_DRIVER
	---help---
		Real-time clock with calendar and alarm, exposed as /dev/rtc0.

		Note that this cannot be combined with RTC_ARCH.  That option
		builds the arch RTC interface on top of the driver interface,
		which is for parts that do not implement up_rtc_* themselves;
		this one does.  Enabling both defines g_rtc_enabled twice, in
		da1470x_rtc.c and in drivers/timers/arch_rtc.c, and the build
		fails at the link with a duplicate symbol under -fno-common --
		a long way from the option that caused it, and in a file
		nobody merging a defconfig from another chip would think to
		look at.

config DA1470X_PDC
	bool "Power Domain Controller (PDC)"
	default n
	---help---
		Driver for the PDC lookup table that wakes the M33 from sleep on
		RTC, timer, GPIO or radio events.

config DA1470X_TICKLESS
	bool "Tickless system time from a low power timer"
	default n
	select SCHED_TICKLESS
	select SCHED_TICKLESS_ALARM
	---help---
		Take the system time from one of the general purpose timers
		running off the low power clock instead of from SysTick.

		SysTick counts the processor clock, so with it as the time base
		the core has to wake at every tick and loses time whenever its
		clock stops.  The timer block sits in PD_TIM and keeps counting
		while PD_SYS is off, so the idle logic can ask for a wake-up
		seconds away and the part can actually sleep in between.

		Resolution is one low power clock cycle, about 30 us with the
		32768 Hz crystal.

config DA1470X_TICKLESS_MAX_SLEEP_MS
	int "Longest the system may sleep without waking (ms, 0 = no limit)"
	default 0
	range 0 250000
	depends on DA1470X_TICKLESS
	---help---
		Wake the system at least this often even when nothing has asked
		to be woken.  Zero lets it sleep until the next thing that is
		actually due, which is what costs least.

		A limit is worth setting when something outside the system time
		has to be noticed -- a console with no wake-up pin behind it, or
		a watchdog -- because it bounds how long the board can appear
		unresponsive.

config DA1470X_TICKLESS_TIMER
	int "Timer instance carrying the system time"
	default 2
	range 1 2
	depends on DA1470X_TICKLESS
	---help---
		Only TIMER and TIMER2 can be clocked from the low power clock
		and stay alive while the system sleeps.  TIMER is the one with
		the four capture inputs, so the second is the better default to
		spend on the clock.

config DA1470X_PM
	bool "Power management (CONFIG_PM lower half)"
	default n
	depends on DA1470X_PDC
	select PM
	---help---
		Implement the NuttX PM states on the DA1470x: IDLE = WFI,
		STANDBY = clock-gated sleep with all RAM retained and PD_SYS
		kept alive.

config DA1470X_PM_DISABLE_DEBUGGER
	bool "Close the debug port while the system sleeps"
	default y
	depends on DA1470X_PM
	---help---
		An enabled debug port keeps part of the clock tree alive whether
		or not a probe is attached, which is current spent for nothing
		once the system is asleep.  Close it on the way down and open it
		again on the way back up.

		While the part sleeps a probe cannot attach.  The way back in is
		a reset through the reset pin, which restarts the boot ROM and
		re-opens the port -- the same reset tools/da1470x_flash.sh
		already performs, so flashing keeps working.

config DA1470X_PM_EXTENDED_SLEEP
	bool "Extended sleep (PD_SYS off) for PM_SLEEP"
	default n
	depends on DA1470X_PM
	---help---
		Save the core context and let the PMU switch PD_SYS off for the
		PM_SLEEP state, resuming through the reset vector.

		INCOMPLETE -- do not enable.  The part does sleep and does wake,
		but the resume is not recognised and every wake-up comes back as
		a cold boot, so a board with this on boot-loops.

		Two things are missing.  The reset status register cannot tell a
		wake-up from a reset here: RESET_ON_WAKEUP sends the wake-up
		through the boot ROM, which leaves the same bits set as the
		reset pin does, and nothing clears them in between.  And the
		power domain controller has a trigger pending as soon as the
		system stops, so it wakes again immediately.

		The way out is the one the vendor SDK takes: drop
		RESET_ON_WAKEUP so the wake-up does not reset anything, put the
		vector table and the resume path in retained RAM and point the
		remap at it, so the processor comes back without the boot ROM
		and without needing the flash controller before it has been set
		up again.  That is a change to how this port boots, which is why
		it is not done here.

config DA1470X_PM_LOWER_V12
	bool "Drop the core rail to 0.9 V while the clock is lowered"
	default n
	depends on DA1470X_PM
	---help---
		The core only needs 1.2 V for the PLL and for the faster
		settings of the high speed RC oscillator.  While a low-power
		state holds the system clock at the 32 MHz crystal the rail can
		come down to 0.9 V.

		This is off by default because the read timing the boot ROM
		programmed into the flash controller was chosen at 1.2 V, so a
		part that reads its code over OQSPI should be measured at the
		lower voltage before trusting it.

config DA1470X_PM_WAKE_GPIO
	bool "Let a pin wake the system from extended sleep"
	default n
	depends on DA1470X_PM
	---help---
		With PD_SYS switched off an interrupt no longer reaches the
		processor; only the power domain controller can bring it back.
		Register a pin with the controller so that an edge on it wakes
		the system.

		The console receive line is the usual choice, so that a board
		asleep on the bench still answers a keystroke.

config DA1470X_PM_WAKE_GPIO_PORT
	int "Port of the wake-up pin"
	default 2
	range 0 2
	depends on DA1470X_PM_WAKE_GPIO

config DA1470X_PM_WAKE_GPIO_PIN
	int "Pin number of the wake-up pin"
	default 1
	range 0 31
	depends on DA1470X_PM_WAKE_GPIO

config DA1470X_CHARGER
	bool "Battery charger"
	default n
	select BATTERY_CHARGER
	---help---
		The charger is a state machine in hardware: given the charge
		voltage, the currents and the temperature limits it walks
		pre-charge, constant current, constant voltage and end of charge
		by itself, and interrupts when the state changes or something is
		wrong.  This exposes it as a NuttX battery charger device,
		conventionally /dev/charger0.

		It is registered with charging disabled.  Enable it through
		BATIOC_OPERATE once the application knows what is connected.

		Measuring the cell is a separate matter: the charger has no
		converter of its own, so a battery voltage needs DA1470X_SDADC.

config DA1470X_CHARGER_VOLTAGE
	int "Charge voltage (mV)"
	default 4200
	range 2800 4800
	depends on DA1470X_CHARGER
	---help---
		4200 is the usual constant-voltage point of a single lithium
		cell.  The hardware takes 50 mV steps below 3800 mV and 20 mV
		steps above it, so a value between steps is rounded down.

config DA1470X_CHARGER_CURRENT
	int "Charge current (uA)"
	default 30000
	range 500 72000
	depends on DA1470X_CHARGER
	---help---
		The constant-current charge rate, at most 72 mA.  A cell should
		not be charged faster than its datasheet allows; for the small
		cells this part is meant for that is usually well under the
		maximum.

config DA1470X_CHARGER_PRECHARGE_VOLTAGE
	int "Pre-charge below this (mV)"
	default 3000
	range 2800 4800
	depends on DA1470X_CHARGER
	---help---
		A deeply discharged cell is brought up gently to this voltage
		before the full charge current is applied.

config DA1470X_CHARGER_PRECHARGE_CURRENT
	int "Pre-charge current (uA)"
	default 3000
	range 500 72000
	depends on DA1470X_CHARGER

config DA1470X_CHARGER_IRQ_HOLDOFF
	int "Quiet time after a charger interrupt (ms)"
	default 50
	range 1 5000
	depends on DA1470X_CHARGER
	---help---
		How long the charger's interrupts stay masked after one is
		taken, before the driver arms them again.

		A charge does not always settle.  Near the end of one the state
		machine sits on the boundary between constant current and
		constant voltage and can cross it repeatedly, and each crossing
		is an interrupt; Renesas ship oscillation detection in their own
		charger service for that reason.  This puts a ceiling on how
		often the interrupt is taken, and coalesces a burst of
		transitions into a single report.

		It is also how late a change can be reported, so it trades one
		against the other.  50 ms is far below what anyone watching a
		battery would notice.

config DA1470X_CHARGER_NTC
	bool "Battery pack has an NTC thermistor"
	default n
	depends on DA1470X_CHARGER
	---help---
		Whether a thermistor is wired to the NTC supply and sense pins
		(P0_11 and P0_29) so that the charger can measure the cell's
		temperature.

		Say y for a pack with a thermistor.  The charger then enforces
		battery temperature protection and can use JEITA, which is what
		a shipping product should do.

		Say n for a bare two-wire cell, which is what the development
		kit is usually given.  With no thermistor the sense input reads
		out of range, the charger reports the battery as too hot and
		refuses to start, so both battery temperature protection and
		JEITA -- which the hardware cannot do without it -- are turned
		off.

		Turning them off means nothing measures the cell's temperature.
		Die temperature protection still applies, but that watches this
		chip rather than the battery, and a cell can be in trouble while
		the die is cool.  Keep the charge current low, do not leave an
		unattended cell charging, and set this back to y for hardware
		that has the thermistor.

config DA1470X_PSRAM
	bool "Quad-SPI PSRAM on QSPIC2"
	default n
	---help---
		Bring up an AP Memory APS6404 PSRAM on the second quad-SPI
		controller and map it at 0x28000000, readable and writable like
		any other memory.  The development kit has one on the
		motherboard, U2, 8 MiB.

		The memory is external: the SoC provides only the controller.
		It is slower than internal RAM and the window is cacheable, so
		it suits large buffers the processor works on; anything a DMA
		engine reads from it -- a frame buffer, say -- has to be cleaned
		from the cache first.

		The part is identified and its address and data lines tested
		before it is used, so a board without one simply reports it
		missing.

if DA1470X_PSRAM

config DA1470X_PSRAM_SIZE
	hex "PSRAM size"
	default 0x800000
	---help---
		How much memory is behind the window.  The APS6404 is 8 MiB.

config DA1470X_PSRAM_HEAP
	bool "Give the PSRAM a heap of its own"
	default y
	---help---
		Manage the PSRAM as a separate heap, reached through
		da1470x_psram_malloc() and da1470x_psram_free().  It is kept
		out of the system heap on purpose, so that nothing ordinary
		lands in slow external memory without asking to.

endif # DA1470X_PSRAM

config DA1470X_PWM
	bool "Timer PWM outputs"
	default n
	select PWM
	---help---
		Drive a pin from one of the general purpose timers as a pulse
		width modulated output, registered as a NuttX PWM device.
		TIMER3 to TIMER6 are available; each has one output, so each
		is one device with one channel.

		TIMER and TIMER2 are deliberately not offered: the tickless
		clock is built on TIMER2.

		A vibration motor is the reason this exists, but nothing in it
		assumes one.  Note that the timer is clocked from the divided
		system clock, so the output stops when that clock does; driving
		something through a sleep state needs the system held awake.

config DA1470X_GPADC
	bool "General purpose ADC"
	default n
	select ADC
	---help---
		The general purpose converter, registered as a NuttX ADC
		device, conventionally /dev/adc0.

		Note that this is not the sigma-delta converter.  That one is
		the audio input, with a programmable gain amplifier in front of
		it and no route to any supply; DA1470X_AUDIO drives it.  This
		is the converter with the battery, the system supply, the
		charger input and the regulated rails wired to it internally.

		It reports MILLIVOLTS rather than counts.  Every internal
		channel sits behind a scaler of its own, so counts from two
		channels are not the same quantity and are not much use on
		their own.

config DA1470X_SNC
	bool "Sensor node controller (second Cortex-M0+)"
	default n
	---help---
		Load firmware into the sensor node controller and run it.  It is
		a Cortex-M0+ with the PD_SNC peripherals wired to it -- the
		UARTs, SPI and I2C controllers, the DMA -- and two RAM cells of
		its own, and it keeps running while the rest of the system
		sleeps.

		What it is for is the work that would otherwise wake the
		application processor for nothing.  A wake of the M33 costs
		about 39 uC on this board, so a sensor polled at a hundred
		hertz costs milliamps before the sensor is even read; the same
		poll here costs a fraction of it, and the M33 is told only when
		something has happened.

		The 64 KiB the controller uses is already kept out of NuttX's
		way by the board's linker script.

config DA1470X_SNC_SMOKETEST
	bool "Prove the controller runs at bring-up"
	default n
	depends on DA1470X_SNC
	---help---
		Start a firmware that signs its own RAM and then counts, and
		report whether the signature arrived and the count moved.  Worth
		having the first time the second processor is brought up on a
		board, and not worth the 36 bytes afterwards.

config DA1470X_OQSPI_MTD
	bool "OQSPI flash controller MTD driver"
	default n
	select MTD
	select MTD_BYTE_WRITE
	select MTD_PARTITION
	---help---
		Expose the boot flash behind the OQSPI controller as an MTD
		device.  Program and erase run from RAM with interrupts masked
		because the code executes in place from the same flash.

config DA1470X_OQSPI_MTD_OFFSET
	hex "Offset of the MTD partition in flash"
	default 0x400000
	depends on DA1470X_OQSPI_MTD

config DA1470X_OQSPI_MTD_SIZE
	hex "Size of the MTD partition"
	default 0x400000
	depends on DA1470X_OQSPI_MTD

config DA1470X_LCDC
	bool "LCD controller (framebuffer)"
	default n
	select VIDEO_FB
	select FB_UPDATE
	---help---
		Display controller driver exposed through /dev/fb0.

config DA1470X_LCDC_TE
	bool "Synchronise frame updates to the panel tearing-effect line"
	default n
	depends on DA1470X_LCDC

config DA1470X_LCDC_NBUFFERS
	int "Number of frame buffers"
	default 2
	range 1 2
	depends on DA1470X_LCDC
	---help---
		With two buffers the framebuffer reports twice the visible
		height; clients draw into either half and pan to it, which
		lets a renderer prepare one frame while the other is shown.

		Weigh that against what it costs, because on a 1 MiB part it
		is most of the memory.  Two buffers for the 390x390 panel at
		16 bits is 608 KiB.  A system that is only driving the display
		can afford it, which is why two is the default; a system that
		is also running a graphics toolkit, a filesystem and a
		Bluetooth host cannot.  Measured with one such: the libc heap
		sat at 99% full, 712960 of 720008 bytes, with the largest free
		block down to 7048 bytes.  One buffer fixed it outright.

config DA1470X_LCDC_ASYNC
	bool "Send frames from a driver thread"
	default y
	depends on DA1470X_LCDC && DA1470X_LCDC_NBUFFERS = 2
	---help---
		An update taken from another frame buffer than the previous
		one returns at once and the frame goes out from a driver
		thread, so a double-buffering client (LVGL) draws its next
		frame during the transfer and the tearing-effect wait.
		Updates of the same buffer stay synchronous.

config DA1470X_LCDC_ASYNC_PRIORITY
	int "Priority of the frame transfer thread"
	default 180
	depends on DA1470X_LCDC_ASYNC


config DA1470X_GPU
	bool "GPU (D/AVE 2D) driver"
	default n
	---help---
		Native register-level driver for the 2D graphics accelerator,
		exposed as /dev/gpu0.

config DA1470X_TCS
	bool "Factory trim values from the OTP configuration script"
	default n
	---help---
		Read the configuration script that the factory burnt into the
		one-time-programmable memory and keep the per-die trim values
		it carries.  The register pairs of the always-on domains are
		written at boot; the radio and synthesiser values are handed
		to the Bluetooth controller.

		Without this the chip runs on reset trim values.  Everything
		works, but the radio is tens of decibels off target, so this
		is effectively required for Bluetooth.

config DA1470X_TCS_DATA_WORDS
	int "Words reserved for the trim values"
	default 256
	range 32 512
	depends on DA1470X_TCS
	---help---
		Size of the array that holds the collected trim values.  The
		configuration script cannot be longer than 256 words, so the
		default always fits.

config DA1470X_BLE
	bool "Bluetooth LE (CMAC controller + HCI transport)"
	default n
	depends on DA1470X_PDC && (DA1470X_CLOCK_XTAL32M_SRC || DA1470X_CLOCK_PLL160_SRC)
	select DA1470X_TCS
	select ALLOW_BSD_COMPONENTS
	select NET
	select NETDEVICES
	select NETDEV_LATEINIT
	select WIRELESS
	select WIRELESS_BLUETOOTH
	select WIRELESS_BLUETOOTH_HOST
	select NET_BLUETOOTH
	select SCHED_HPWORK
	---help---
		Load the CMAC controller firmware and register a NuttX HCI
		driver over the CPUAPP/CMAC mailbox.

config DA1470X_CMAC_FW_PATH
	string "Path of the CMAC firmware binary (relative to the NuttX tree)"
	default "../Renesas_SDK-10.2.6.49/cmac_fw.bin"
	depends on DA1470X_BLE
	---help---
		Firmware area extracted from the SDK's libble_stack_da1470x.a
		with tools/da1470x_cmac_fw.sh.  The controller only sleeps with
		XTAL32K as low-power clock; with RCLP it is kept awake.

config DA1470X_PWMLED
	bool "PWM LED driver block"
	default n
	select PWM
	---help---
		Expose the three constant-current LED outputs of the PWMLED
		block as a NuttX PWM lower half (channels 1..3 sharing one
		period, 31 Hz..7.8 kHz).

config DA1470X_AUDIO
	bool "Audio unit (rate converter, microphone and serial port)"
	default n
	depends on DA1470X_DMA
	select AUDIO
	---help---
		Capture and playback through the sample rate converter.  A
		digital microphone on the pulse density interface, or a codec
		on the pulse code serial port, becomes a NuttX audio device.

		One channel per path only: the two channels of the converter
		appear at separate data registers and would need a second DMA
		channel and a second buffer.

config DA1470X_AUDIO_BUFSIZE
	int "Size of one audio buffer (bytes)"
	default 4096
	depends on DA1470X_AUDIO
	---help---
		Reported to the upper half when it asks how to size the
		buffers it allocates.

config DA1470X_AUDIO_NBUFFERS
	int "Number of audio buffers"
	default 4
	range 2 16
	depends on DA1470X_AUDIO
	---help---
		Two is the fewest that keeps the hardware fed while a finished
		buffer is being handled.

config DA1470X_VAD
	bool "Voice activity detector"
	default n
	---help---
		The always-on block that listens for a sound louder than the
		background noise and raises an interrupt.  It runs from the
		low power oscillator or the 32kHz crystal and keeps working
		while the rest of the chip sleeps, so it can be used as a
		wake-up source.

		Detections are read from a character device, conventionally
		/dev/vad0.

config DA1470X_VAD_NEVENTS
	int "Detections buffered"
	default 8
	range 1 64
	depends on DA1470X_VAD
	---help---
		A reader that falls behind loses the oldest detections; each
		delivered detection says how many were dropped before it.

config DA1470X_VAD_NPOLLWAITERS
	int "Poll waiters on the detector"
	default 2
	range 1 8
	depends on DA1470X_VAD

config DA1470X_WDT
	bool "System watchdog"
	default n
	select WATCHDOG
	---help---
		Expose the system watchdog as a NuttX watchdog device, usually
		/dev/watchdog0.  It counts down once every 10 ms from a 13-bit
		reload, so the longest timeout it can be given is a little under
		82 seconds.

		It is registered stopped, so nothing resets the board until
		something opens the device and starts it.

		Two things about this watchdog are worth knowing before relying
		on it.  Freezing it does not survive sleep: the datasheet says
		that entering any sleep mode with PD_SYS switched off resumes it
		regardless, so a system sleeping longer than the timeout is
		reset while it sleeps.  And a capture handler does not prevent
		the reset -- it arrives on the watchdog's NMI and has the 160 ms
		before the hardware resets anyway.

config DA1470X_WDT_DEFTIMEOUT
	int "Default timeout (ms)"
	default 20000
	range 10 81910
	depends on DA1470X_WDT
	---help---
		What the watchdog is loaded with until something sets a timeout
		of its own.

config DA1470X_WDOG_FREEZE
	bool "Freeze the system watchdog at boot"
	default y
	---help---
		The SYS watchdog is running out of reset and would reset the
		chip after about 10 seconds.  Freeze it until a watchdog driver
		takes over.

		This is what DA1470X_WDT takes over from: it registers the
		device stopped and lets go of this freeze only when something
		starts it.

config DA1470X_DMA_SMOKETEST
	bool "Run a memory-to-memory DMA smoke test at bring-up"
	default n
	depends on DA1470X_DMA

endmenu # DA1470X Peripheral Selection

menu "High Frequency Clock (HFCLK) Configuration"

choice
	prompt "Select HFCLK Source"
	default DA1470X_CLOCK_XTAL32M_SRC

config DA1470X_CLOCK_XTAL32M_SRC
	bool "XTAL32M (external 32 MHz crystal)"
	---help---
		Start the 32 MHz crystal oscillator and run the system clock
		from it.  Required for the radio and for accurate peripheral
		timing.

config DA1470X_CLOCK_PLL160_SRC
	bool "PLL at 160 MHz (from the XTAL32M crystal)"
	---help---
		Start the crystal and the system PLL and run the core at
		160 MHz.  The flash controller runs at 80 MHz.  The
		peripheral clock stays at 32 MHz.

config DA1470X_CLOCK_RCHS_SRC
	bool "RCHS (internal high-speed RC oscillator)"

endchoice

if DA1470X_CLOCK_RCHS_SRC

choice
	prompt "RCHS frequency"
	default DA1470X_CLOCK_HFCLK_SRC_RCHS_32

config DA1470X_CLOCK_HFCLK_SRC_RCHS_32
	bool "32 MHz"

config DA1470X_CLOCK_HFCLK_SRC_RCHS_64
	bool "64 MHz"

config DA1470X_CLOCK_HFCLK_SRC_RCHS_96
	bool "96 MHz"

endchoice

endif # DA1470X_CLOCK_RCHS_SRC

endmenu

menu "Low Power Clock (LFCLK) Configuration"

config DA1470X_USE_LFCLK
	bool "Enable Low Power Clock (LFCLK)"
	default y

if DA1470X_USE_LFCLK

choice
	prompt "Select LFCLK Source"
	default DA1470X_CLOCK_LPCLK_SRC_RCLP

config DA1470X_CLOCK_LPCLK_SRC_RCLP
	bool "RCLP (internal 32 kHz RC, inaccurate)"

config DA1470X_CLOCK_LPCLK_SRC_RCX
	bool "RCX (internal 32 kHz RC, calibrated)"

config DA1470X_CLOCK_LPCLK_SRC_XTAL32K
	bool "XTAL32K (external 32.768 kHz crystal)"

config DA1470X_CLOCK_LPCLK_SRC_EXTERNAL
	bool "External clock on a GPIO"

endchoice

config DA1470X_XTAL32K_SETTLE_MS
	int "How long to wait for the 32.768 kHz crystal to start"
	default 1000
	range 1 4000
	depends on DA1470X_CLOCK_LPCLK_SRC_XTAL32K
	---help---
		The crystal has no ready flag, so the system runs on the RC
		oscillator until a counter clocked from the low power clock is
		seen to move with the crystal selected.  A watch crystal needs
		a few hundred milliseconds of bias; this is how long to keep
		looking before deciding it is not fitted and going back to the
		RC oscillator.

endif # DA1470X_USE_LFCLK

endmenu
```
